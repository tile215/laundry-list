//load servo library
#include <Servo.h>

//keep set pins for controlling servo motors
#define Lservo 13 //left
#define Rservo 12 //right

//pin for LED
#define LEDpin 10

//this is a servo to activate the button on the remote control to advance the pulley
#define controllerServo 5

//initialise 2 servos using the servo library, one left, and one right.
Servo servoL;
Servo servoR;
//as well 1 servo for the controller
Servo controller;

//set pin for the button input
#define buttonInput 4


//please note that this variable has no direct implementation right now, but in the future, should more features be automated and an LCD display be added,
//this may prove very useful.
//~~~~~~~~~~~~~~~~~~~~~~~~~~~~~~~~~~~~~~~~~~~~~~~~~~~~~~~|
//global variable to keep track of the number of tasks.  |     
//This is equal to the number of items on the pulley     |
int numTasks = 4;                                      //|
//~~~~~~~~~~~~~~~~~~~~~~~~~~~~~~~~~~~~~~~~~~~~~~~~~~~~~~~|


//global variable to know when a task is completed
boolean taskCompleted = false;

//function to advance the pulley. To be implemented later.
void pulleyAdvance(int time) {
  //The pulley advancing mechanism is a dollar store RC car. As such, to activate the switch, the button on the remote control is pressed by a servo.
  controller.write(70);
  delay(time);
  controller.write(0);
}

void blinkLED(int n) {
  //loop for n times
  for(int i = n; i > 0; i--) {
    // turn the LED on, voltage set to HIGH
    digitalWrite(LEDpin, HIGH);   
    //wait some amount of time. LED remains on
    delay(100);
    //voltage now set to LOW, so LED goes off.                       
    digitalWrite(LEDpin, LOW);
    // wait again
    delay(100);                       
  }
}

//abstract away the logic of the scissor cutting action
void cut() {
  //local variable to keep track of the angle of the servo motors
  int theta = 0;
  //opening scissors:
  //Theta starts at 0, and counts the absolute value of the change of position in degrees.
  //The angle made when the scissors are closed is roughly 10 degrees, so theta only counts to 80 not 90
  //Theta continues until 80 so it opens a total of 90 degrees 
  for (theta = 0; theta < 80; theta++) {
      //for this 5 bar linkage, the left servo rotates counterclockwise to open the scissors
      //while the right servo opens clockwise.
      //the reference position for the scissors is 80 degrees (scissors are closed) 

      //for the left servo, theta is subtracted from the beggining angle as it needs to rotate counterclockwise
      servoL.write(80-theta);
      //for the right servo, theta is added to 80 as it needs to rotate clockwise.
      servoR.write(80+theta);
      //the length of the delay sets the speed of the action
      //longer delay means that more time is taken between each increment of movement.             
      delay(7);                   
  }
  
  //closing scissors:
  //Now, theta starts at 80 as 80 - 80 = 0 which is the angle when the scissors are fully open
  //as theta decreases, the angle of the stepper motors gets closer to 80 which is the rest position
  for(theta = 80; theta > 0; theta--) {

    //same as above, because the servos are rotating in different directions, the nominal angle is different
    //but the angles generated by each servo with respect to the centerline of the scissor mechanism 
    //(from joint of scissors to the middle of the block that the 2 servos are attached to) remain equal.                                
    servoL.write(80-theta);
    servoR.write(80+theta);
    delay(7);       
  }
}


//advance pulley, open, then close scissors
void removeTask() {
  //blink the LED so the user knows something is happening
  blinkLED(5); 

  //2 cuts are made just in case 1 fails. Redundency = good
  cut();
  delay(50);
  cut();
  delay(50);
  //move pulley forwards for 1 second.
  //Motion is via an RC car, not a stepper motor, so no precise distance control yet
  pulleyAdvance(1000);

}

void setup() {
  // put your setup code here, to run once:

  //set the button as an input to detect when it is pressed
  pinMode(buttonInput, INPUT);

  //set LEDpin as output
  pinMode(LEDpin, OUTPUT);

  //using the servo library, the ports for "Lservo" and "Rservo" are set as servo controlling ports
  //for the left and right servos respectively
  servoL.attach(Lservo);
  servoR.attach(Rservo);
  //attach controllerServo to controller
  controller.attach(controllerServo);
}

void loop() {
  //logic to detect when the button is pressed:
  //First, check if a signal is detected throught the corresponding button pin
  //As well, make sure that the machine is not getting rid of a task
  //then, wait some amount of time. This is to get rid of "noise" or false signals
  boolean buttonState = digitalRead(buttonInput);

  if (buttonState) {
     delay(30);
     if (buttonState) {
        //at this point, we know the button has been activated, but need to wait until released
        //to start the task removal process
        while (buttonState) {
          removeTask();
          delay(50);
          //update buttonState
          buttonState = digitalRead(buttonInput);
        }
        //then we set taskCompleted to true to begin removing a task
        taskCompleted = true;
     }
  }
  //useful feature for the future: keeping track of the number of tasks.
  if (taskCompleted) {
    numTasks--;
  }
}
